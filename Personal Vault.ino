 byte f[100][8] = {
  {0x00, 0xff, 0x99, 0x99, 0x99, 0x99, 0x99, 0xff}, //0
  {0x00, 0xf2, 0x96, 0x9a, 0x92, 0x92, 0x92, 0xf7}, //1
  {0x00, 0xf7, 0x91, 0x91, 0x92, 0x94, 0x94, 0xf7}, //2
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  {0x00, 0xff, 0x99, 0x99, 0xff, 0x11, 0x11, 0xff}, //99
};


byte error[8] = {0x00, 0x66, 0x99, 0x11, 0x22, 0x44, 0x00, 0x44};

#include <LedControl.h>
#include <Servo.h>

#define encoder0CLK 2
#define encoder0DT 3
#define encoder0SW A2

#define lcdDIN 13
#define lcdCS 11
#define lcdCLK 10

#define buttonPin 4
#define redLED 7
#define yellowLED 6
#define greenLED 5

#define servoPin 9

static int pinA = 2; // Our first hardware interrupt pin is digital pin 2
static int pinB = 3; // Our second hardware interrupt pin is digital pin 3
volatile byte aFlag = 0; // let's us know when we're expecting a rising edge on pinA to signal that the encoder has arrived at a detent
volatile byte bFlag = 0; // let's us know when we're expecting a rising edge on pinB to signal that the encoder has arrived at a detent (opposite direction to when aFlag is set)
volatile byte encoderPos = 0; //this variable stores our current value of encoder position. Change to int or uin16_t instead of byte if you want to record a larger range than 0-255
volatile byte oldEncPos = 0; //stores the last encoder position value so we can compare to the current reading and see if it has changed (so we know when to print to the serial monitor)
volatile byte reading = 0; //somewhere to store the direct values we read from our interrupt pins before checking to see if we have moved a whole detent

bool pressed = false;
LedControl lc = LedControl(lcdDIN, lcdCLK, lcdCS, 0);

int pos;
Servo Servo1;

int password;

bool lock = false;
void setup() {

  lc.shutdown(0, false);      //The MAX72XX is in power-saving mode on startup
  lc.setIntensity(0, 5);     // Set the brightness to maximum value
  lc.clearDisplay(0);         // and clear the display

  // initialize the pushbutton pin as an input:
  pinMode(buttonPin, INPUT);
  pinMode(redLED, OUTPUT);
  pinMode(yellowLED, OUTPUT);
  pinMode(greenLED, OUTPUT);

  digitalWrite(greenLED, HIGH);

  pinMode(pinA, INPUT_PULLUP); // set pinA as an input, pulled HIGH to the logic voltage (5V or 3.3V for most cases)
  pinMode(pinB, INPUT_PULLUP); // set pinB as an input, pulled HIGH to the logic voltage (5V or 3.3V for most cases)
  attachInterrupt(0, PinA, RISING); // set an interrupt on PinA, looking for a rising edge signal and executing the "PinA" Interrupt Service Routine (below)
  attachInterrupt(1, PinB, RISING); // set an interrupt on PinB, looking for a rising edge signal and executing the "PinB" Interrupt Service Routine (below)
  Serial.begin(115200); // start the serial monitor link

  Servo1.attach(servoPin);
  Servo1.write(0);
}

void PinA() {
  cli(); //stop interrupts happening before we read pin values
  reading = PIND & 0xC; // read all eight pin values then strip away all but pinA and pinB's values
  if (reading == B00001100 && aFlag) { //check that we have both pins at detent (HIGH) and that we are expecting detent on this pin's rising edge
    encoderPos --; //decrement the encoder's position count
    bFlag = 0; //reset flags for the next turn
    aFlag = 0; //reset flags for the next turn
  }
  else if (reading == B00000100) bFlag = 1; //signal that we're expecting pinB to signal the transition to detent from free rotation
  sei(); //restart interrupts
}

void PinB() {
  cli(); //stop interrupts happening before we read pin values
  reading = PIND & 0xC; //read all eight pin values then strip away all but pinA and pinB's values
  if (reading == B00001100 && bFlag) { //check that we have both pins at detent (HIGH) and that we are expecting detent on this pin's rising edge
    encoderPos ++; //increment the encoder's position count
    bFlag = 0; //reset flags for the next turn
    aFlag = 0; //reset flags for the next turn
  }
  else if (reading == B00001000) aFlag = 1; //signal that we're expecting pinA to signal the transition to detent from free rotation
  sei(); //restart interrupts
}
void(* resetFunc) (void) = 0; //declare reset function @ address 0

void loop() {
  Serial.println(encoderPos);
  if (checkButtonPressed(oldEncPos) == true) {
    reset();

    printToLcd(oldEncPos);

    digitalWrite(greenLED, LOW);
    digitalWrite(yellowLED, HIGH);

    lock = true;
    close_servo();
  }

  while ( lock == true) {

    if (checkInput(oldEncPos) == false) {
      
      readRotaryEncoder();

    } else {
      digitalWrite(yellowLED, LOW);
      Serial.println("Correct. Open the vault ....");
      resetFunc();
    }
  }

  readRotaryEncoder();
}

void readRotaryEncoder() {
  if (oldEncPos != encoderPos) {
    Serial.println(encoderPos);
    oldEncPos = encoderPos;
    printToLcd(oldEncPos);
  }

}


void reset() {
  encoderPos = 0;
  oldEncPos = encoderPos;
}


void printByte(byte character [])
{

  int i = 0;
  for (i = 0; i < 8; i++)
  {
    lc.setRow(0, i, character[i]);
  }
}
void printToLcd(int index) {

  if ( index < 0 || index > 100 ) {
    printByte(error);
  } else {
    printByte(f[index]);
  }
}


bool checkButtonPressed(int number) {
  if ( digitalRead(buttonPin) == HIGH && checkPassword(number) == true) {
    password = number;
    Serial.println("Password Save Sucessfully");
    return true;
  } else {
    return 0;
  }
}

bool checkInput(int num) {
  if (digitalRead(buttonPin) == HIGH && num == password) {

    return true;

  } else if (digitalRead(buttonPin) == HIGH && num != password) {
    Serial.println("Incorrect. Give it another try ....");
    digitalWrite(redLED, HIGH);
    delay(1);
    digitalWrite(redLED, LOW);
    return false;
  }

}

bool checkPassword(int num) {
  if ( num >= 0 && num < 100) {
    return true;
  } else {
    return false;
  }
}


void close_servo() {
  Servo1.attach(9); // attaches the servo on pin 9 to the servo object

  for (pos = 0; pos <= 180; pos += 1) { // goes from 0 degrees to 180 degrees
    // in steps of 1 degree
    Servo1.write(pos); // tell servo to go to position in variable 'pos'
    delay(15); // waits 15ms for the servo to reach the position
  }
  Servo1.detach();// detach the servo from arduino
  delay(1000);
}
